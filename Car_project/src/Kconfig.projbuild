## Car_project/src/Kconfig.projbuild
```kconfig
menu "Wi-Fi and MQTT Configuration"
    config WIFI_SSID
        string "Wi-Fi SSID"
        default ""
        help
            Enter your Wi-Fi network name.
    config WIFI_PASSWORD
        string "Wi-Fi Password"
        default ""
        help
            Enter your Wi-Fi password.
    config OTA_HTTPS_URL
        string "OTA HTTPS URL"
        default "https://your-server.com/update.bin"
        help
            URL of the binary file for OTA updates.
    config OTA_MQTTS_HOSTNAME
        string "MQTT Hostname"
        default "your-id.s1.eu.hivemq.cloud"
    config OTA_MQTTS_USERNAME
        string "MQTT Username"
        default ""
    config OTA_MQTTS_PASSWORD
        string "MQTT Password"
        default ""
endmenu
```
